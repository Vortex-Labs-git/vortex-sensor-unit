## main/Kconfig.projbuild
```kconfig
menu "WiFi Mode Configuration"

    menu "SoftAP Configuration"
        comment "SoftAP Configuration"

        config ESP_WIFI_AP_SSID
            string "WiFi AP SSID"
            default "SU200001001"
            help
                SSID (network name) of the AP for the example to connect to.

        config ESP_WIFI_AP_PASSWORD
            string "WiFi AP Password"
            default "12345678"
            help
                WiFi password of the AP for the example to use.

        config ESP_WIFI_AP_CHANNEL
            int "WiFi AP Channel"
            range 1 14
            default 1
            help
                WiFi channel (network channel) of the AP for the example to use.

        config ESP_MAX_STA_CONN_AP
            int "Maximal STA connections"
            default 4
            help
                Max number of the STA connects to AP.
    endmenu

    menu "STA Configuration"
        comment "STA Configuration"

        config ESP_WIFI_STA_MODE_RESET
            bool "Reset WiFi Storage to Default"
            default n
            help
                Reset WiFi storage to default values.

        config ESP_WIFI_STA_SSID
            string "WiFi SSID"
            default "sta_ssid"
            help
                SSID (network name) for the example's sta to connect to.

        config ESP_WIFI_STA_PASSWD
            string "WiFi Password"
            default "sta_password"
            help
                WiFi password for the example to use.

        config ESP_WIFI_STA_MAXIMUM_RETRY
            int "Maximum retry"
            default 5
            help
                Set the maximum retry value to prevent the station from continuously
                attempting to reconnect to the Access Point (AP) when the AP doesn't exist.

    endmenu
endmenu


menu "Device Configuration"
    menu "Device Data Configuration"
        comment "Device Data Configuration"

        config SENSOR_UNIT_ID
            string "Sensor unit ID"
            default "SU202605001"
            help
                Senssor unit Id.

        config WS_PASSKEY_VALUE
            string "WebSocket Passkey"
            default "12345"
            help
                WebSocket passkey for the device.

    endmenu


    menu "AHT10 Sensor Configuration"
        comment "AHT10 Sensor Configuration"

        config AHT10_I2C_PORT
            int "AHT10 I2C port"
            default 0
            range 0 1
            help
                ESP32 I2C port used by the AHT10 sensor.

        config AHT10_SDA_PIN
            int "AHT10 SDA pin"
            default 21
            help
                GPIO pin connected to AHT10 SDA.

        config AHT10_SCL_PIN
            int "AHT10 SCL pin"
            default 22
            help
                GPIO pin connected to AHT10 SCL.

        config AHT10_I2C_ADD
            int "AHT10 I2C address"
            default 54
            help
                I2C address of the sensor  (54 - 0x36)

        config AHT10_READ_INTERVAL_MS
            int "AHT10 read interval in milliseconds"
            default 2000
            range 500 60000
            help
                How often the firmware reads and logs AHT10 temperature and humidity.
    endmenu


    menu "External Sensor Pin Configuration"
        menu "External port 1"
            config SENSOR_02_Pin_A0
                int "Sensor 02 analog pin"
                default 36
            
            config SENSOR_02_Pin_D0
                int "Sensor 02 digital pin"
                default 25
        endmenu

        menu "External port 2"
            config SENSOR_03_Pin_A0
                int "Sensor 03 analog pin"
                default 39
            
            config SENSOR_03_Pin_D0
                int "Sensor 03 digital pin"
                default 26
        endmenu

        menu "External port 3"
            config SENSOR_04_Pin_A0
                int "Sensor 04 analog pin"
                default 34
            
            config SENSOR_04_Pin_D0
                int "Sensor 04 digital pin"
                default 27
        endmenu

        menu "External port 4"
            config SENSOR_05_Pin_A0
                int "Sensor 05 analog pin"
                default 35
            
            config SENSOR_05_Pin_D0
                int "Sensor 05 digital pin"
                default 14
        endmenu

        menu "External port 5"
            config SENSOR_06_Pin_A0
                int "Sensor 06 analog pin"
                default 32
            
            config SENSOR_06_Pin_D0
                int "Sensor 06 digital pin"
                default 13
        endmenu

        menu "External port 6"
            config SENSOR_07_Pin_A0
                int "Sensor 07 analog pin"
                default 33
            
            config SENSOR_07_Pin_D0
                int "Sensor 07 digital pin"
                default 23
        endmenu
  
    endmenu


    menu "External Sensor Map Configuration"
        config SENSOR_CONFIG_RESET
            bool "Reset Sensor config to Default"
            default n
            help
                Reset Sensor config to default values.
        
        config SENSOR_02_TYPE
            int "Sensor S02 Type"
            default 0
            range 0 4
            help 
                sensor port 1 

                0 = SENSOR_NONE
                1 = SENSOR_TEMP
                2 = SENSOR_MOISTURE
                3 = SENSOR_HUMIDITY
                4 = SENSOR_PH
                
        config SENSOR_03_TYPE
            int "Sensor S03 Type"
            default 0
            range 0 4
            help 
                sensor port 2

                0 = SENSOR_NONE
                1 = SENSOR_TEMP
                2 = SENSOR_MOISTURE
                3 = SENSOR_HUMIDITY
                4 = SENSOR_PH

        config SENSOR_04_TYPE
            int "Sensor S04 Type"
            default 0
            range 0 4
            help 
                sensor port 3

        config SENSOR_05_TYPE
            int "Sensor S05 Type"
            default 0
            range 0 4
            help 
                sensor port 4

        config SENSOR_06_TYPE
            int "Sensor S06 Type"
            default 0
            range 0 4
            help 
                sensor port 5

        config SENSOR_07_TYPE
            int "Sensor S07 Type"
            default 0
            range 0 4
            help 
                sensor port 6
    
    endmenu


    menu "LED Indicators Configuration"
        comment "LED Indicators Configuration"

        config RED_LED_PIN
            int "RED LED PIN"
            default 17
            help
                Red LED pin number.

        config GREEN_LED_PIN
            int "GREEN LED PIN"
            default 16
            help
                Green LED pin number.
    endmenu


    menu "MQTT client Configuration"
        comment "MQTT client Configuration"

        config MQTT_BROKER_URI
            string "MQTT BROKER URI"
            default "mqtt://10.217.90.172"
            help
                MQTT broker URI for the device to connect to.

        config MQTT_BASE_TOPIC
            string "MQTT BASE TOPIC"
            default "vortex_device/sensor_unit/"
            help
                MQTT base topic for the device communication.

    endmenu
    
endmenu
```
